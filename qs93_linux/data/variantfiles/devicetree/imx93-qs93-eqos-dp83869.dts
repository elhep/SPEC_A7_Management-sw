/dts-v1/;

/ {

	fragment@0 {
		target-path = "/chosen";

		__overlay__ {

			overlays {
				qs93-eqos-dp83869;
			};
		};
	};

	fragment@1 {
		target = <0xffffffff>;

		__overlay__ {
			pinctrl-names = "default";
			pinctrl-0 = <0x01>;
			phy-handle = <0x02>;
			phy-mode = "rgmii-id";
			status = "okay";

			mdio {
                compatible = "snps,dwmac-mdio";
				pinctrl-names = "default";
				pinctrl-0 = <0x03>;
				reset-gpios = <0xffffffff 0x04 0x01>;
				reset-delay-us = <0x61a8>;
				reset-post-delay-us = <0x64>;
				#address-cells = <0x01>;
				#size-cells = <0x00>;

				ethernet-phy@a {
			        reg = <0xa>;
                    pinctrl-names = "default";
					pinctrl-0 = <0x04>;
                    interrupt-parent = <0xffffffff>;
					interrupts = <0x05 0x02>;
					eee-broken-1000t;
					phandle = <0x02>;
			        tx-fifo-depth = <0x01>;
                    rx-fifo-depth = <0x01>;
                    ti,op-mode = <0x00>;
                    ti,max-output-impedance;
                    ti,clk-output-sel = <0x0>;
                    rx-internal-delay-ps = <0x7D0>;
                    tx-internal-delay-ps = <0x7D0>;
				};
			};
		};
	};

	fragment@2 {
		target = <0xffffffff>;

		__overlay__ {

			eqos-rgmiigrp {
				fsl,pins = <0x98 0x248 0x00 0x00 0x00 0x106 0x9c 0x24c 0x00 0x00 0x00 0x106 0xc0 0x270 0x00 0x00 0x00 0x300 0xc4 0x274 0x00 0x00 0x00 0x300 0xc8 0x278 0x00 0x00 0x00 0x300 0xcc 0x27c 0x00 0x00 0x00 0x300 0xb8 0x268 0x00 0x00 0x00 0x500 0xbc 0x26c 0x00 0x00 0x00 0x500 0x88 0x238 0x00 0x00 0x00 0x30e 0xac 0x25c 0x00 0x00 0x00 0x51e 0xa8 0x258 0x00 0x00 0x00 0x51e 0xa4 0x254 0x00 0x00 0x00 0x51e 0xa0 0x250 0x00 0x00 0x00 0x51e 0xb4 0x264 0x00 0x00 0x00 0x51e 0xb0 0x260 0x00 0x00 0x00 0x51e>;
				phandle = <0x01>;
			};

			ethphy0-intgrp {
				fsl,pins = <0x164 0x314 0x00 0x05 0x00 0x17e>;
				phandle = <0x04>;
			};

			ethphy0-rstgrp {
				fsl,pins = <0x160 0x310 0x00 0x05 0x00 0x17e>;
				phandle = <0x03>;
			};
		};
	};

	__symbols__ {
		ethphy0 = "/fragment@1/__overlay__/mdio/ethernet-phy@a";
		pinctrl_eqos_rgmii = "/fragment@2/__overlay__/eqos-rgmiigrp";
		pinctrl_ethphy0_int = "/fragment@2/__overlay__/ethphy0-intgrp";
		pinctrl_ethphy0_rst = "/fragment@2/__overlay__/ethphy0-rstgrp";
	};

	__fixups__ {
		eqos = "/fragment@1:target:0";
		gpio3 = "/fragment@1/__overlay__/mdio:reset-gpios:0\0/fragment@1/__overlay__/mdio/ethernet-phy@a:interrupt-parent:0";
		iomuxc = "/fragment@2:target:0";
	};

	__local_fixups__ {

		fragment@1 {

			__overlay__ {
				pinctrl-0 = <0x00>;
				phy-handle = <0x00>;

				mdio {
					pinctrl-0 = <0x00>;

					ethernet-phy@a {
						pinctrl-0 = <0x00>;
					};
				};
			};
		};
	};
};
